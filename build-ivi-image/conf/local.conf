## build-ivi-image/conf/local.conf
```bitbake
# ===============================
# MACHINE / DISTRO
# ===============================
MACHINE ?= "beaglebone"
DISTRO ?= "poky" 
PACKAGE_CLASSES ?= "package_rpm"
EXTRA_IMAGE_FEATURES ?= "debug-tweaks"
USER_CLASSES ?= "buildstats"
PATCHRESOLVE = "noop"
BB_DISKMON_DIRS ??= " \
    STOPTASKS,${TMPDIR},1G,100K \
    STOPTASKS,${DL_DIR},1G,100K \
    STOPTASKS,${SSTATE_DIR},1G,100K \
    STOPTASKS,/tmp,100M,100K \
    HALT,${TMPDIR},100M,1K \
    HALT,${DL_DIR},100M,1K \
    HALT,${SSTATE_DIR},100M,1K \
    HALT,/tmp,10M,1K \
    "
CONF_VERSION = "2"


# ===============================
# setup directories
# ===============================
MYDIR := "/home/suker/myYocto" 
DL_DIR ?= "${MYDIR}/downloads" 
SSTATE_DIR ?= "${MYDIR}/sstate-cache" 
TMPDIR = "${TOPDIR}/tmp" 
RM_OLD_IMAGE = "1"

# ===============================
# MACHINE_FEATURES
# ===============================
MACHINE_FEATURES:remove = " gpu"

# ===============================
# DISTRO_FEATURES
# ===============================
DISTRO_FEATURES = "systemd udev alsa splash"
DISTRO_FEATURES:append = " opengl wayland pam bluetooth"

VIRTUAL-RUNTIME_init_manager = "systemd" 
DISTRO_FEATURES_BACKFILL_CONSIDERED = "sysvinit"

# ===============================
# PREFERRED_PROVIDER OVERRIDE
# ===============================
PREFERRED_PROVIDER_virtual/gpudriver ?= ""
PREFERRED_PROVIDER_virtual/mesa ?= ""
PREFERRED_PROVIDER_virtual/libgles2 ?= ""

# ===============================
# setup QT
# ===============================
PACKAGECONFIG:remove:pn-qtbase = " x11 eglfs"
PACKAGECONFIG:append:pn-qtbase = " wayland gles2"
PACKAGECONFIG:append:pn-qtdeclarative = " quick"
PACKAGECONFIG:append:pn-qtmultimedia = " multimedia"
PACKAGECONFIG:append:pn-qtconnectivity = " bluetooth"
PACKAGECONFIG:append:pn-weston = " fbdev "

# ===============================
# Build Options
# ===============================
UBOOT_MMC_BOOT_BUILD_CONFIG = "1"

# ===============================
# for SDK
# ===============================
#TOOLCHAIN_TARGET_TASK:append = " kernel-devsrc"

# for ffmpeg commercial error prevent
LICENSE_FLAGS_ACCEPTED:append = " commercial"
```
