## build-full-cmdline/conf/bblayers.conf
```bitbake
# POKY_BBLAYERS_CONF_VERSION is increased each time build/conf/bblayers.conf
# changes incompatibly
POKY_BBLAYERS_CONF_VERSION = "2"

BBPATH = "${TOPDIR}"
BBFILES ?= ""

BBLAYERS ?= " \
  /home/suker/myYocto/poky/meta \
  /home/suker/myYocto/poky/meta-poky \
  /home/suker/myYocto/poky/meta-yocto-bsp \
  /home/suker/myYocto/poky/meta-openembedded/meta-oe \
  /home/suker/myYocto/poky/meta-openembedded/meta-multimedia \
  /home/suker/myYocto/poky/meta-openembedded/meta-python \
  /home/suker/myYocto/poky/meta-arm/meta-arm-toolchain \
  /home/suker/myYocto/poky/meta-arm/meta-arm \
  /home/suker/myYocto/poky/meta-ti/meta-ti-bsp \
  /home/suker/myYocto/poky/meta-qt5 \
  /home/suker/myYocto/poky/meta-sukerbeaglebone \
  "
```

## build-full-cmdline/conf/local.conf
```bitbake
# ===============================
# MACHINE / DISTRO
# ===============================
MACHINE ?= "beaglebone"
DISTRO ?= "poky" 
PACKAGE_CLASSES ?= "package_rpm"
EXTRA_IMAGE_FEATURES ?= "debug-tweaks"
USER_CLASSES ?= "buildstats"
PATCHRESOLVE = "noop"
BB_DISKMON_DIRS ??= " \
    STOPTASKS,${TMPDIR},1G,100K \
    STOPTASKS,${DL_DIR},1G,100K \
    STOPTASKS,${SSTATE_DIR},1G,100K \
    STOPTASKS,/tmp,100M,100K \
    HALT,${TMPDIR},100M,1K \
    HALT,${DL_DIR},100M,1K \
    HALT,${SSTATE_DIR},100M,1K \
    HALT,/tmp,10M,1K \
    "
CONF_VERSION = "2"


# ===============================
# setup directories
# ===============================
MYDIR := "/home/suker/myYocto" 
DL_DIR ?= "${MYDIR}/downloads" 
SSTATE_DIR ?= "${MYDIR}/sstate-cache" 
TMPDIR = "${TOPDIR}/tmp" 
RM_OLD_IMAGE = "1"

# ===============================
# DISTRO_FEATURES
# ===============================
DISTRO_FEATURES = "systemd udev alsa splash" 
DISTRO_FEATURES:remove = " opengl wayland"

VIRTUAL-RUNTIME_init_manager = "systemd" 
DISTRO_FEATURES_BACKFILL_CONSIDERED = "sysvinit"

# ===============================
# setup QT
# ===============================
PACKAGECONFIG:remove:pn-qtbase = "wayland gles2 x11 eglfs"
PACKAGECONFIG:append:pn-qtbase = " linuxfb"

# ===============================
# Build Options
# ===============================
UBOOT_MMC_BOOT_BUILD_CONFIG = "1"
```

## meta-sukerbeaglebone/conf/layer.conf
```bitbake
# We have a conf and classes directory, add to BBPATH
BBPATH .= ":${LAYERDIR}"

# We have recipes-* directories, add to BBFILES
BBFILES += "${LAYERDIR}/recipes-*/*/*.bb \
            ${LAYERDIR}/recipes-*/*/*.bbappend"

BBFILE_COLLECTIONS += "meta-suker"
BBFILE_PATTERN_meta-suker = "^${LAYERDIR}/"
BBFILE_PRIORITY_meta-suker = "9"

LAYERDEPENDS_meta-suker = "core"
LAYERSERIES_COMPAT_meta-suker = "kirkstone"
```
